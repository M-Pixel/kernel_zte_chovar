/* Copyright (c) 2012, Code Aurora Forum. All rights reserved.
 *
 * This program is free software; you can redistribute it and/or modify
 * it under the terms of the GNU General Public License version 2 and
 * only version 2 as published by the Free Software Foundation.
 *
 * This program is distributed in the hope that it will be useful,
 * but WITHOUT ANY WARRANTY; without even the implied warranty of
 * MERCHANTABILITY or FITNESS FOR A PARTICULAR PURPOSE.  See the
 * GNU General Public License for more details.
 */

/*---------------------------------------------------------------------------
 * This file is autogenerated file using gcdb parser. Please do not edit it.
 * Update input XML file to add a new entry or update variable in this file
 * VERSION = "1.0"
 *---------------------------------------------------------------------------*/
&mdss_mdp {

        dsi_nt35590_tm_5p0_720p_cmd_305:qcom,mdss_dsi_nt35590_tm_5p0_720p_cmd_305 {
              compatible = "qcom,mdss-dsi-panel";
              qcom,mdss-dsi-panel-name =  "zteTM_TM(NT35590B)_720*1280_5.0Inch-305";
              status = "disable";
		
              zte,lcd-product = <305>;
		qcom,mdss-pan-physical-height-dimension = <110>;
		qcom,mdss-pan-physical-width-dimension = <62>;

		qcom,mdss-dsi-panel-controller = <&mdss_dsi0>;
		qcom,mdss-dsi-panel-type = "dsi_cmd_mode";
		qcom,mdss-dsi-panel-destination = "display_1";
		qcom,mdss-dsi-panel-framerate = <60>;
		qcom,mdss-dsi-virtual-channel-id = <0>;
		qcom,mdss-dsi-stream = <0>;
		qcom,mdss-dsi-panel-width = <720>;
		qcom,mdss-dsi-panel-height = <1280>;
		qcom,mdss-dsi-h-front-porch = <140>;
		qcom,mdss-dsi-h-back-porch = <164>;
		qcom,mdss-dsi-h-pulse-width = <8>;
		qcom,mdss-dsi-h-sync-skew = <0>;
		qcom,mdss-dsi-v-back-porch = <11>;
		qcom,mdss-dsi-v-front-porch = <8>;
		qcom,mdss-dsi-v-pulse-width = <3>;
		qcom,mdss-dsi-h-left-border = <0>;
		qcom,mdss-dsi-h-right-border = <0>;
		qcom,mdss-dsi-v-top-border = <0>;
		qcom,mdss-dsi-v-bottom-border = <0>;
		qcom,mdss-dsi-bpp = <24>;
		qcom,mdss-dsi-color-order = <0>;
		qcom,mdss-dsi-underflow-color = <0xff>;
		qcom,mdss-dsi-border-color = <0>;
		
		qcom,mdss-dsi-h-sync-pulse = <1>;
		qcom,mdss-dsi-traffic-mode = <2>;
		qcom,mdss-dsi-lane-map = <0>;
		qcom,mdss-dsi-bllp-eof-power-mode;
		qcom,mdss-dsi-bllp-power-mode;
		qcom,mdss-dsi-lane-0-state;
		qcom,mdss-dsi-lane-1-state;
		qcom,mdss-dsi-lane-2-state;
		qcom,mdss-dsi-lane-3-state;
		qcom,mdss-dsi-te-pin-select = <1>;
		qcom,mdss-dsi-te-v-sync-rd-ptr-irq-line = <0x2c>;
		qcom,mdss-dsi-te-dcs-command = <1>;
		qcom,mdss-dsi-te-check-enable;
		qcom,mdss-dsi-te-using-te-pin;
		qcom,mdss-dsi-panel-timings = [93 1E 14 00 44 48 18 22 19 03 04 00];
		qcom,mdss-dsi-t-clk-post = <0x0a>;
		qcom,mdss-dsi-t-clk-pre = <0x1d>;
		qcom,mdss-dsi-bl-min-level = <1>;
		qcom,mdss-dsi-bl-max-level = <30>;
		qcom,mdss-dsi-dma-trigger = <0x04>;
		qcom,mdss-dsi-mdp-trigger = <0x0>;
		qcom,mdss-dsi-bl-pmic-control-type = "bl_ctrl_gpio";
		qcom,mdss-dsi-bl-cmd-gpio = <&msmgpio 1 0>;
		qcom,mdss-dsi-reset-sequence = <1 10>, <0 20>, <1 10>;

    qcom,mdss-dsi-on-command = [
     39 01 00 00 00 00 02 FF 00
     39 01 00 00 00 00 02 55 b0
     39 01 00 00 00 00 02 FB 01
     39 01 00 00 00 00 06 3b 03 07 04 3c 3c
     39 01 00 00 00 00 02 FF 01
     39 01 00 00 00 00 02 FB 01
     39 01 00 00 00 00 02 00 3A
     39 01 00 00 00 00 02 01 33
     39 01 00 00 00 00 02 08 66
     39 01 00 00 00 00 02 09 8F
     39 01 00 00 00 00 02 0B C2
     39 01 00 00 00 00 02 0C C2
     39 01 00 00 00 00 02 0D 24
     39 01 00 00 00 00 02 0E 33
     39 01 00 00 00 00 02 11 94
     39 01 00 00 00 00 02 12 03
     39 01 00 00 00 00 02 0F 0A
     39 01 00 00 00 00 02 36 73
     39 01 00 00 00 00 02 71 2C
     39 01 00 00 00 00 02 FF 05
     39 01 00 00 00 00 02 FB 01
     39 01 00 00 00 00 02 01 00
     39 01 00 00 00 00 02 02 86
     39 01 00 00 00 00 02 03 86
     39 01 00 00 00 00 02 04 86
     39 01 00 00 00 00 02 05 30
     39 01 00 00 00 00 02 06 33
     39 01 00 00 00 00 02 07 77
     39 01 00 00 00 00 02 08 00
     39 01 00 00 00 00 02 09 00
     39 01 00 00 00 00 02 0A 00
     39 01 00 00 00 00 02 0B 80
     39 01 00 00 00 00 02 0C C8
     39 01 00 00 00 00 02 0D 0A
     39 01 00 00 00 00 02 0E 1B
     39 01 00 00 00 00 02 0F 06
     39 01 00 00 00 00 02 10 56
     39 01 00 00 00 00 02 11 00
     39 01 00 00 00 00 02 12 00
     39 01 00 00 00 00 02 13 1E
     39 01 00 00 00 00 02 14 00
     39 01 00 00 00 00 02 15 1A
     39 01 00 00 00 00 02 16 05
     39 01 00 00 00 00 02 17 00
     39 01 00 00 00 00 02 18 1E
     39 01 00 00 00 00 02 19 FF
     39 01 00 00 00 00 02 1A 00
     39 01 00 00 00 00 02 1B FC
     39 01 00 00 00 00 02 1C 80
     39 01 00 00 00 00 02 1D 00
     39 01 00 00 00 00 02 1E 00
     39 01 00 00 00 00 02 1F 77
     39 01 00 00 00 00 02 20 00
     39 01 00 00 00 00 02 21 00
     39 01 00 00 00 00 02 22 55
     39 01 00 00 00 00 02 23 0D
     39 01 00 00 00 00 02 31 A0
     39 01 00 00 00 00 02 32 00
     39 01 00 00 00 00 02 33 B8
     39 01 00 00 00 00 02 34 BB
     39 01 00 00 00 00 02 35 11
     39 01 00 00 00 00 02 36 02
     39 01 00 00 00 00 02 37 00
     39 01 00 00 00 00 02 38 01
     39 01 00 00 00 00 02 39 0B
     39 01 00 00 00 00 02 44 08
     39 01 00 00 00 00 02 45 80
     39 01 00 00 00 00 02 46 CC
     39 01 00 00 00 00 02 47 04
     39 01 00 00 00 00 02 48 00
     39 01 00 00 00 00 02 49 00
     39 01 00 00 00 00 02 4A 01
     39 01 00 00 00 00 02 6C 03
     39 01 00 00 00 00 02 6D 03
     39 01 00 00 00 00 02 6E 2F
     39 01 00 00 00 00 02 43 00
     39 01 00 00 00 00 02 4B 23
     39 01 00 00 00 00 02 4C 01
     39 01 00 00 00 00 02 50 23
     39 01 00 00 00 00 02 51 01
     39 01 00 00 00 00 02 58 23
     39 01 00 00 00 00 02 59 01
     39 01 00 00 00 00 02 5D 23
     39 01 00 00 00 00 02 5E 01
     39 01 00 00 00 00 02 89 00
     39 01 00 00 00 00 02 8D 01
     39 01 00 00 00 00 02 8E 64
     39 01 00 00 00 00 02 8F 20
     39 01 00 00 00 00 02 97 8E
     39 01 00 00 00 00 02 82 8C
     39 01 00 00 00 00 02 83 02
     39 01 00 00 00 00 02 BB 0A
     39 01 00 00 00 00 02 BC 0A
     39 01 00 00 00 00 02 24 25
     39 01 00 00 00 00 02 25 55
     39 01 00 00 00 00 02 26 05
     39 01 00 00 00 00 02 27 23
     39 01 00 00 00 00 02 28 01
     39 01 00 00 00 00 02 29 31
     39 01 00 00 00 00 02 2A 5D
     39 01 00 00 00 00 02 2B 01
     39 01 00 00 00 00 02 2F 00
     39 01 00 00 00 00 02 30 10
     39 01 00 00 00 00 02 A7 12
     39 01 00 00 00 00 02 2D 03
     39 01 00 00 00 00 02 FF 00
     39 01 00 00 00 00 02 FF 01
     39 01 00 00 00 00 02 75 01
     39 01 00 00 00 00 02 76 3E
     39 01 00 00 00 00 02 77 01
     39 01 00 00 00 00 02 78 40
     39 01 00 00 00 00 02 79 01
     39 01 00 00 00 00 02 7A 42
     39 01 00 00 00 00 02 7B 01
     39 01 00 00 00 00 02 7C 50
     39 01 00 00 00 00 02 7D 01
     39 01 00 00 00 00 02 7E 55
     39 01 00 00 00 00 02 7F 01
     39 01 00 00 00 00 02 80 58
     39 01 00 00 00 00 02 81 01
     39 01 00 00 00 00 02 82 60
     39 01 00 00 00 00 02 83 01
     39 01 00 00 00 00 02 84 6A
     39 01 00 00 00 00 02 85 01
     39 01 00 00 00 00 02 86 6E
     39 01 00 00 00 00 02 87 01
     39 01 00 00 00 00 02 88 8A
     39 01 00 00 00 00 02 89 01
     39 01 00 00 00 00 02 8A 9D
     39 01 00 00 00 00 02 8B 01
     39 01 00 00 00 00 02 8C C7
     39 01 00 00 00 00 02 8D 01
     39 01 00 00 00 00 02 8E EA
     39 01 00 00 00 00 02 8F 02
     39 01 00 00 00 00 02 90 20
     39 01 00 00 00 00 02 91 02
     39 01 00 00 00 00 02 92 4E
     39 01 00 00 00 00 02 93 02
     39 01 00 00 00 00 02 94 51
     39 01 00 00 00 00 02 95 02
     39 01 00 00 00 00 02 96 81
     39 01 00 00 00 00 02 97 02
     39 01 00 00 00 00 02 98 B9
     39 01 00 00 00 00 02 99 02
     39 01 00 00 00 00 02 9A DD
     39 01 00 00 00 00 02 9B 03
     39 01 00 00 00 00 02 9C 0F
     39 01 00 00 00 00 02 9D 03
     39 01 00 00 00 00 02 9E 2D
     39 01 00 00 00 00 02 9F 03
     39 01 00 00 00 00 02 A0 61
     39 01 00 00 00 00 02 A2 03
     39 01 00 00 00 00 02 A3 75
     39 01 00 00 00 00 02 A4 03
     39 01 00 00 00 00 02 A5 89
     39 01 00 00 00 00 02 A6 03
     39 01 00 00 00 00 02 A7 AD
     39 01 00 00 00 00 02 A9 03
     39 01 00 00 00 00 02 AA C7
     39 01 00 00 00 00 02 AB 03
     39 01 00 00 00 00 02 AC D7
     39 01 00 00 00 00 02 AD 03
     39 01 00 00 00 00 02 AE E2
     39 01 00 00 00 00 02 AF 03
     39 01 00 00 00 00 02 B0 EB
     39 01 00 00 00 00 02 B1 03
     39 01 00 00 00 00 02 B2 F2
     39 01 00 00 00 00 02 B3 01
     39 01 00 00 00 00 02 B4 3E
     39 01 00 00 00 00 02 B5 01
     39 01 00 00 00 00 02 B6 40
     39 01 00 00 00 00 02 B7 01
     39 01 00 00 00 00 02 B8 42
     39 01 00 00 00 00 02 B9 01
     39 01 00 00 00 00 02 BA 50
     39 01 00 00 00 00 02 BB 01
     39 01 00 00 00 00 02 BC 55
     39 01 00 00 00 00 02 BD 01
     39 01 00 00 00 00 02 BE 58
     39 01 00 00 00 00 02 BF 01
     39 01 00 00 00 00 02 C0 60
     39 01 00 00 00 00 02 C1 01
     39 01 00 00 00 00 02 C2 6A
     39 01 00 00 00 00 02 C3 01
     39 01 00 00 00 00 02 C4 6E
     39 01 00 00 00 00 02 C5 01
     39 01 00 00 00 00 02 C6 8A
     39 01 00 00 00 00 02 C7 01
     39 01 00 00 00 00 02 C8 9D
     39 01 00 00 00 00 02 C9 01
     39 01 00 00 00 00 02 CA C7
     39 01 00 00 00 00 02 CB 01
     39 01 00 00 00 00 02 CC EA
     39 01 00 00 00 00 02 CD 02
     39 01 00 00 00 00 02 CE 20
     39 01 00 00 00 00 02 CF 02
     39 01 00 00 00 00 02 D0 4E
     39 01 00 00 00 00 02 D1 02
     39 01 00 00 00 00 02 D2 51
     39 01 00 00 00 00 02 D3 02
     39 01 00 00 00 00 02 D4 81
     39 01 00 00 00 00 02 D5 02
     39 01 00 00 00 00 02 D6 B9
     39 01 00 00 00 00 02 D7 02
     39 01 00 00 00 00 02 D8 DD
     39 01 00 00 00 00 02 D9 03
     39 01 00 00 00 00 02 DA 0F
     39 01 00 00 00 00 02 DB 03
     39 01 00 00 00 00 02 DC 2D
     39 01 00 00 00 00 02 DD 03
     39 01 00 00 00 00 02 DE 61
     39 01 00 00 00 00 02 DF 03
     39 01 00 00 00 00 02 E0 75
     39 01 00 00 00 00 02 E1 03
     39 01 00 00 00 00 02 E2 89
     39 01 00 00 00 00 02 E3 03
     39 01 00 00 00 00 02 E4 AD
     39 01 00 00 00 00 02 E5 03
     39 01 00 00 00 00 02 E6 C7
     39 01 00 00 00 00 02 E7 03
     39 01 00 00 00 00 02 E8 D7
     39 01 00 00 00 00 02 E9 03
     39 01 00 00 00 00 02 EA E2
     39 01 00 00 00 00 02 EB 03
     39 01 00 00 00 00 02 EC EB
     39 01 00 00 00 00 02 ED 03
     39 01 00 00 00 00 02 EE F2
     39 01 00 00 00 00 02 EF 01
     39 01 00 00 00 00 02 F0 3E
     39 01 00 00 00 00 02 F1 01
     39 01 00 00 00 00 02 F2 40
     39 01 00 00 00 00 02 F3 01
     39 01 00 00 00 00 02 F4 42
     39 01 00 00 00 00 02 F5 01
     39 01 00 00 00 00 02 F6 50
     39 01 00 00 00 00 02 F7 01
     39 01 00 00 00 00 02 F8 55
     39 01 00 00 00 00 02 F9 01
     39 01 00 00 00 00 02 FA 58
     39 01 00 00 00 00 02 FF 00
     39 01 00 00 00 00 02 FF 02
     39 01 00 00 00 00 02 00 01
     39 01 00 00 00 00 02 01 60
     39 01 00 00 00 00 02 02 01
     39 01 00 00 00 00 02 03 6A
     39 01 00 00 00 00 02 04 01
     39 01 00 00 00 00 02 05 6E
     39 01 00 00 00 00 02 06 01
     39 01 00 00 00 00 02 07 8A
     39 01 00 00 00 00 02 08 01
     39 01 00 00 00 00 02 09 9D
     39 01 00 00 00 00 02 0A 01
     39 01 00 00 00 00 02 0B C7
     39 01 00 00 00 00 02 0C 01
     39 01 00 00 00 00 02 0D EA
     39 01 00 00 00 00 02 0E 02
     39 01 00 00 00 00 02 0F 20
     39 01 00 00 00 00 02 10 02
     39 01 00 00 00 00 02 11 4E
     39 01 00 00 00 00 02 12 02
     39 01 00 00 00 00 02 13 51
     39 01 00 00 00 00 02 14 02
     39 01 00 00 00 00 02 15 81
     39 01 00 00 00 00 02 16 02
     39 01 00 00 00 00 02 17 B9
     39 01 00 00 00 00 02 18 02
     39 01 00 00 00 00 02 19 DD
     39 01 00 00 00 00 02 1A 03
     39 01 00 00 00 00 02 1B 0F
     39 01 00 00 00 00 02 1C 03
     39 01 00 00 00 00 02 1D 2D
     39 01 00 00 00 00 02 AE 03
     39 01 00 00 00 00 02 1F 61
     39 01 00 00 00 00 02 20 03
     39 01 00 00 00 00 02 21 75
     39 01 00 00 00 00 02 22 03
     39 01 00 00 00 00 02 23 89
     39 01 00 00 00 00 02 24 03
     39 01 00 00 00 00 02 25 AD
     39 01 00 00 00 00 02 26 03
     39 01 00 00 00 00 02 27 C7
     39 01 00 00 00 00 02 28 03
     39 01 00 00 00 00 02 29 D7
     39 01 00 00 00 00 02 2A 03
     39 01 00 00 00 00 02 2B E2
     39 01 00 00 00 00 02 2D 03
     39 01 00 00 00 00 02 2F EB
     39 01 00 00 00 00 02 30 03
     39 01 00 00 00 00 02 31 F2
     39 01 00 00 00 00 02 32 01
     39 01 00 00 00 00 02 33 3E
     39 01 00 00 00 00 02 34 01
     39 01 00 00 00 00 02 35 40
     39 01 00 00 00 00 02 36 01
     39 01 00 00 00 00 02 37 42
     39 01 00 00 00 00 02 38 01
     39 01 00 00 00 00 02 39 50
     39 01 00 00 00 00 02 3A 01
     39 01 00 00 00 00 02 3B 55
     39 01 00 00 00 00 02 3D 01
     39 01 00 00 00 00 02 3F 58
     39 01 00 00 00 00 02 40 01
     39 01 00 00 00 00 02 41 60
     39 01 00 00 00 00 02 42 01
     39 01 00 00 00 00 02 43 6A
     39 01 00 00 00 00 02 44 01
     39 01 00 00 00 00 02 45 6E
     39 01 00 00 00 00 02 46 01
     39 01 00 00 00 00 02 47 8A
     39 01 00 00 00 00 02 48 01
     39 01 00 00 00 00 02 49 9D
     39 01 00 00 00 00 02 4A 01
     39 01 00 00 00 00 02 4B C7
     39 01 00 00 00 00 02 4C 01
     39 01 00 00 00 00 02 4D EA
     39 01 00 00 00 00 02 4E 02
     39 01 00 00 00 00 02 4F 20
     39 01 00 00 00 00 02 50 02
     39 01 00 00 00 00 02 51 4E
     39 01 00 00 00 00 02 52 02
     39 01 00 00 00 00 02 53 51
     39 01 00 00 00 00 02 54 02
     39 01 00 00 00 00 02 55 81
     39 01 00 00 00 00 02 56 02
     39 01 00 00 00 00 02 58 B9
     39 01 00 00 00 00 02 59 02
     39 01 00 00 00 00 02 5A DD
     39 01 00 00 00 00 02 5B 03
     39 01 00 00 00 00 02 5C 0F
     39 01 00 00 00 00 02 5D 03
     39 01 00 00 00 00 02 5E 2D
     39 01 00 00 00 00 02 5F 03
     39 01 00 00 00 00 02 60 61
     39 01 00 00 00 00 02 61 03
     39 01 00 00 00 00 02 62 75
     39 01 00 00 00 00 02 63 03
     39 01 00 00 00 00 02 64 89
     39 01 00 00 00 00 02 65 03
     39 01 00 00 00 00 02 66 AD
     39 01 00 00 00 00 02 67 03
     39 01 00 00 00 00 02 68 C7
     39 01 00 00 00 00 02 69 03
     39 01 00 00 00 00 02 6A D7
     39 01 00 00 00 00 02 6B 03
     39 01 00 00 00 00 02 6C E2
     39 01 00 00 00 00 02 6D 03
     39 01 00 00 00 00 02 6E EB
     39 01 00 00 00 00 02 6F 03
     39 01 00 00 00 00 02 70 F2
     39 01 00 00 00 00 02 71 01
     39 01 00 00 00 00 02 72 3E
     39 01 00 00 00 00 02 73 01
     39 01 00 00 00 00 02 74 40
     39 01 00 00 00 00 02 75 01
     39 01 00 00 00 00 02 76 42
     39 01 00 00 00 00 02 77 01
     39 01 00 00 00 00 02 78 50
     39 01 00 00 00 00 02 79 01
     39 01 00 00 00 00 02 7A 55
     39 01 00 00 00 00 02 7B 01
     39 01 00 00 00 00 02 7C 58
     39 01 00 00 00 00 02 7D 01
     39 01 00 00 00 00 02 7E 60
     39 01 00 00 00 00 02 7F 01
     39 01 00 00 00 00 02 80 6A
     39 01 00 00 00 00 02 81 01
     39 01 00 00 00 00 02 82 6E
     39 01 00 00 00 00 02 83 01
     39 01 00 00 00 00 02 84 8A
     39 01 00 00 00 00 02 85 01
     39 01 00 00 00 00 02 86 9D
     39 01 00 00 00 00 02 87 01
     39 01 00 00 00 00 02 88 C7
     39 01 00 00 00 00 02 89 01
     39 01 00 00 00 00 02 8A EA
     39 01 00 00 00 00 02 8B 02
     39 01 00 00 00 00 02 8C 20
     39 01 00 00 00 00 02 8D 02
     39 01 00 00 00 00 02 8E 4E
     39 01 00 00 00 00 02 8F 02
     39 01 00 00 00 00 02 90 51
     39 01 00 00 00 00 02 91 02
     39 01 00 00 00 00 02 92 81
     39 01 00 00 00 00 02 93 02
     39 01 00 00 00 00 02 94 B9
     39 01 00 00 00 00 02 95 02
     39 01 00 00 00 00 02 96 DD
     39 01 00 00 00 00 02 97 03
     39 01 00 00 00 00 02 98 0F
     39 01 00 00 00 00 02 99 03
     39 01 00 00 00 00 02 9A 2D
     39 01 00 00 00 00 02 9B 03
     39 01 00 00 00 00 02 9C 61
     39 01 00 00 00 00 02 9D 03
     39 01 00 00 00 00 02 9E 75
     39 01 00 00 00 00 02 9F 03
     39 01 00 00 00 00 02 A0 89
     39 01 00 00 00 00 02 A2 03
     39 01 00 00 00 00 02 A3 AD
     39 01 00 00 00 00 02 A4 03
     39 01 00 00 00 00 02 A5 C7
     39 01 00 00 00 00 02 A6 03
     39 01 00 00 00 00 02 A7 D7
     39 01 00 00 00 00 02 A9 03
     39 01 00 00 00 00 02 AA E2
     39 01 00 00 00 00 02 AB 03
     39 01 00 00 00 00 02 AC EB
     39 01 00 00 00 00 02 AD 03
     39 01 00 00 00 00 02 AE F2
     39 01 00 00 00 00 02 AF 01
     39 01 00 00 00 00 02 B0 3E
     39 01 00 00 00 00 02 B1 01
     39 01 00 00 00 00 02 B2 40
     39 01 00 00 00 00 02 B3 01
     39 01 00 00 00 00 02 B4 42
     39 01 00 00 00 00 02 B5 01
     39 01 00 00 00 00 02 B6 50
     39 01 00 00 00 00 02 B7 01
     39 01 00 00 00 00 02 B8 55
     39 01 00 00 00 00 02 B9 01
     39 01 00 00 00 00 02 BA 58
     39 01 00 00 00 00 02 BB 01
     39 01 00 00 00 00 02 BC 60
     39 01 00 00 00 00 02 BD 01
     39 01 00 00 00 00 02 BE 6A
     39 01 00 00 00 00 02 BF 01
     39 01 00 00 00 00 02 C0 6E
     39 01 00 00 00 00 02 C1 01
     39 01 00 00 00 00 02 C2 8A
     39 01 00 00 00 00 02 C3 01
     39 01 00 00 00 00 02 C4 9D
     39 01 00 00 00 00 02 C5 01
     39 01 00 00 00 00 02 C6 C7
     39 01 00 00 00 00 02 C7 01
     39 01 00 00 00 00 02 C8 EA
     39 01 00 00 00 00 02 C9 02
     39 01 00 00 00 00 02 CA 20
     39 01 00 00 00 00 02 CB 02
     39 01 00 00 00 00 02 CC 4E
     39 01 00 00 00 00 02 CD 02
     39 01 00 00 00 00 02 CE 51
     39 01 00 00 00 00 02 CF 02
     39 01 00 00 00 00 02 D0 81
     39 01 00 00 00 00 02 D1 02
     39 01 00 00 00 00 02 D2 B9
     39 01 00 00 00 00 02 D3 02
     39 01 00 00 00 00 02 D4 DD
     39 01 00 00 00 00 02 D5 03
     39 01 00 00 00 00 02 D6 0F
     39 01 00 00 00 00 02 D7 03
     39 01 00 00 00 00 02 D8 2D
     39 01 00 00 00 00 02 D9 03
     39 01 00 00 00 00 02 DA 61
     39 01 00 00 00 00 02 DB 03
     39 01 00 00 00 00 02 DC 75
     39 01 00 00 00 00 02 DD 03
     39 01 00 00 00 00 02 DE 89
     39 01 00 00 00 00 02 DF 03
     39 01 00 00 00 00 02 E0 AD
     39 01 00 00 00 00 02 E1 03
     39 01 00 00 00 00 02 E2 C7
     39 01 00 00 00 00 02 E3 03
     39 01 00 00 00 00 02 E4 D7
     39 01 00 00 00 00 02 E5 03
     39 01 00 00 00 00 02 E6 E2
     39 01 00 00 00 00 02 E7 03
     39 01 00 00 00 00 02 E8 EB
     39 01 00 00 00 00 02 E9 03
     39 01 00 00 00 00 02 EA F2
     39 01 00 00 00 00 02 FF 03
     39 01 00 00 00 00 02 FB 01
     39 01 00 00 00 00 02 00 00
     39 01 00 00 00 00 02 01 06
     39 01 00 00 00 00 02 02 0c
     39 01 00 00 00 00 02 03 12
     39 01 00 00 00 00 02 04 18
     39 01 00 00 00 00 02 05 1e
     39 01 00 00 00 00 02 06 24
     39 01 00 00 00 00 02 07 24
     39 01 00 00 00 00 02 08 1e
     39 01 00 00 00 00 02 09 18
     39 01 00 00 00 00 02 0A 0c
     39 01 00 00 00 00 02 0B 00
     39 01 00 00 00 00 02 0C 00
     39 01 00 00 00 00 02 0D 00
     39 01 00 00 00 00 02 0E 00
     39 01 00 00 00 00 02 0F 00
     39 01 00 00 00 00 02 1B 25
     39 01 00 00 00 00 02 1C 2a
     39 01 00 00 00 00 02 1D 28
     39 01 00 00 00 00 02 1E 26
     39 01 00 00 00 00 02 1F 24
     39 01 00 00 00 00 02 20 22
     39 01 00 00 00 00 02 24 00
     39 01 00 00 00 00 02 25 40
     39 01 00 00 00 00 02 18 00
     39 01 00 00 00 00 02 19 00
     39 01 00 00 00 00 02 1A 00
     39 01 00 00 00 00 02 21 00
     39 01 00 00 00 00 02 22 00
     39 01 00 00 00 00 02 23 00
     39 01 00 00 00 00 02 FF 00
     39 01 00 00 00 00 02 FB 01
     39 01 00 00 00 00 02 C2 08
     39 01 00 00 00 00 02 BA 03                               
     05 01 00 00 78 00 02 11 00 
     05 01 00 00 32 00 02 29 00];
		qcom,mdss-dsi-on-command-state = "dsi_lp_mode";
		qcom,mdss-dsi-off-command = [05 01 00 00 32 00 02 28 00
					                 05 01 00 00 78 00 02 10 00];
                qcom,mdss-dsi-off-command-state = "dsi_hs_mode";
        };
};