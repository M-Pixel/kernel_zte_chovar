/*
 * Copyright (c) 2012-2013, The Linux Foundation. All rights reserved.
 *
 * This program is free software; you can redistribute it and/or modify
 * it under the terms of the GNU General Public License version 2 and
 * only version 2 as published by the Free Software Foundation.
 *
 * This program is distributed in the hope that it will be useful,
 * but WITHOUT ANY WARRANTY; without even the implied warranty of
 * MERCHANTABILITY or FITNESS FOR A PARTICULAR PURPOSE.  See the
 * GNU General Public License for more details.
 */

/*
 * Created by ZTE_JIA_20130828, jia.jia
 */

/*
 * Differential configuration of camera sensor
 *
 * See: arch/arm/boot/dts/msm8974-camera.dtsi
 *      arch/arm/boot/dts/msm8974-camera-sensor-mtp.dtsi
 */
// --->
&cci {
	/*
	 * Support for Sony imx091 13Mp
	 *
	 * 'qcom,camera@X' & 'reg = <0xX>': index of camera sensor for mclk
	 * refer to kernel/arch/arm/mach-msm/clock-8974.c
	 *
	 * 'qcom,csid-sd-index' should be set as same as 'qcom,csiphy-sd-index'
	 * for rear/front camera, otherwise 'csid_open' will return error.
	 */
	qcom,camera@0 {
		/*
		 * CCI configuration
		 */
		qcom,cci-master = <0>;

		/*
		 * Flash configuration
		 */
		qcom,led-flash-src = <&led_flash2>;

		/*
		 * VDD configuration
		 */
		cam_vdig-supply = <&pm8941_l3>;
		cam_vio-supply = <&pm8941_lvs2>;
		cam_vana-supply = <&pm8941_l17>;
		cam_vaf-supply = <&pm8941_l23>;
		qcom,cam-vreg-min-voltage = <1225000 0 2850000 2850000>;
		qcom,cam-vreg-max-voltage = <1225000 0 2850000 2850000>;
		qcom,cam-vreg-op-mode = <105000 0 80000 80000>;

		/*
		 * GPIO configuration
		 */
		gpios = <&msmgpio 15 0>, <&msmgpio 89 0>, <&msmgpio 90 0>;
		qcom,gpio-reset = <2>;
		qcom,gpio-standby = <1>;
		qcom,gpio-req-tbl-num = <0 1 2>;

		/* 0: output gpio, 1: input gpio */
		qcom,gpio-req-tbl-flags = <1 0 0>;

		qcom,gpio-req-tbl-label = "CAM0_MCLK", "CAM0_STANDBY", "CAM0_RESET";
	};

	/*
	 * Support for Sony imx135 13Mp
	 *
	 * 'qcom,camera@X' & 'reg = <0xX>': index of camera sensor for mclk
	 * refer to kernel/arch/arm/mach-msm/clock-8974.c
	 *
	 * 'qcom,csid-sd-index' should be set as same as 'qcom,csiphy-sd-index'
	 * for rear/front camera, otherwise 'csid_open' will return error.
	 */
	qcom,camera@1 {
		/*
		 * CCI configuration
		 */
		qcom,cci-master = <0>;

		/*
		 * Flash configuration
		 */
		qcom,led-flash-src = <&led_flash2>;

		/*
		 * VDD configuration
		 */
		cam_vdig-supply = <&pm8941_l3>;
		cam_vio-supply = <&pm8941_lvs2>;
		cam_vana-supply = <&pm8941_l17>;
		cam_vaf-supply = <&pm8941_l23>;
		qcom,cam-vreg-min-voltage = <1050000 0 2850000 2850000>;
		qcom,cam-vreg-max-voltage = <1050000 0 2850000 2850000>;
		qcom,cam-vreg-op-mode = <105000 0 80000 80000>;

		/*
		 * GPIO configuration
		 */
		gpios = <&msmgpio 15 0>, <&msmgpio 89 0>, <&msmgpio 90 0>;
		qcom,gpio-reset = <2>;
		qcom,gpio-standby = <1>;
		qcom,gpio-req-tbl-num = <0 1 2>;

		/* 0: output gpio, 1: input gpio */
		qcom,gpio-req-tbl-flags = <1 0 0>;

		qcom,gpio-req-tbl-label = "CAM0_MCLK", "CAM0_STANDBY", "CAM0_RESET";
	};
// <---
};
