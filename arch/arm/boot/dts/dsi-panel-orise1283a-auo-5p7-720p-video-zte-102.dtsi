/* Copyright (c) 2012, Code Aurora Forum. All rights reserved.
 *
 * This program is free software; you can redistribute it and/or modify
 * it under the terms of the GNU General Public License version 2 and
 * only version 2 as published by the Free Software Foundation.
 *
 * This program is distributed in the hope that it will be useful,
 * but WITHOUT ANY WARRANTY; without even the implied warranty of
 * MERCHANTABILITY or FITNESS FOR A PARTICULAR PURPOSE.  See the
 * GNU General Public License for more details.
 */

/*---------------------------------------------------------------------------
 * This file is autogenerated file using gcdb parser. Please do not edit it.
 * Update input XML file to add a new entry or update variable in this file
 * VERSION = "1.0"
 *---------------------------------------------------------------------------*/
&mdss_mdp {

        dsi_orise1283a_auo_5p7_720p_video_102:qcom,mdss_dsi_orise1283a_auo_5p7_720p_video_102 {
              compatible = "qcom,mdss-dsi-panel";
              qcom,mdss-dsi-panel-name =  "zteLEAD_AUO(OTM1283A)_720*1280_5.7Inch-old-102";
		
              zte,lcd-product = <102>;
		qcom,mdss-pan-physical-height-dimension = <127>;
		qcom,mdss-pan-physical-width-dimension = <71>;

		qcom,mdss-dsi-panel-controller = <&mdss_dsi0>;
		qcom,mdss-dsi-panel-type = "dsi_video_mode";
		qcom,mdss-dsi-panel-destination = "display_1";
		qcom,mdss-dsi-panel-framerate = <60>;
		qcom,mdss-dsi-virtual-channel-id = <0>;
		qcom,mdss-dsi-stream = <0>;
		qcom,mdss-dsi-panel-width = <720>;
		qcom,mdss-dsi-panel-height = <1280>;
		qcom,mdss-dsi-h-front-porch = <144>;
		qcom,mdss-dsi-h-back-porch = <32>;
		qcom,mdss-dsi-h-pulse-width = <12>;
		qcom,mdss-dsi-h-sync-skew = <0>;
		qcom,mdss-dsi-v-back-porch = <3>;
		qcom,mdss-dsi-v-front-porch = <9>;
		qcom,mdss-dsi-v-pulse-width = <4>;
		qcom,mdss-dsi-h-left-border = <0>;
		qcom,mdss-dsi-h-right-border = <0>;
		qcom,mdss-dsi-v-top-border = <0>;
		qcom,mdss-dsi-v-bottom-border = <0>;
		qcom,mdss-dsi-bpp = <24>;
		qcom,mdss-dsi-color-order = <0>;
		qcom,mdss-dsi-underflow-color = <0xff>;
		qcom,mdss-dsi-border-color = <0>;
		
		qcom,mdss-dsi-h-sync-pulse = <0>;
		qcom,mdss-dsi-traffic-mode = <1>;
		qcom,mdss-dsi-lane-map = <0>;
		qcom,mdss-dsi-bllp-eof-power-mode;
		qcom,mdss-dsi-bllp-power-mode;
		qcom,mdss-dsi-lane-0-state;
		qcom,mdss-dsi-lane-1-state;
		qcom,mdss-dsi-lane-2-state;
		qcom,mdss-dsi-lane-3-state;
		qcom,mdss-dsi-panel-timings = [b0 23 1b 00 94 93 1e 25  15 03 04 00];
		qcom,mdss-dsi-t-clk-post = <0x04>;
		qcom,mdss-dsi-t-clk-pre = <0x1b>;
		qcom,mdss-dsi-bl-min-level = <1>;
		qcom,mdss-dsi-bl-max-level = <4095>;
		qcom,mdss-dsi-dma-trigger = <0x04>;
		qcom,mdss-dsi-mdp-trigger = <0x0>;
		qcom,mdss-dsi-bl-pmic-control-type = "bl_ctrl_wled";
		qcom,mdss-dsi-reset-sequence = <1 10>, <0 20>, <1 10>;
                qcom,mdss-dsi-on-command = [
                                39 01 00 00 00 00 02 00 00                                                                               
                                39 01 00 00 00 00 04 ff 12 83 01 	                                                                  
                                39 01 00 00 00 00 02 00 80 	                                                                            
                                39 01 00 00 00 00 03 ff 12 83                                                                          
                                39 01 00 00 00 00 02 00 a6                                                                               
                                39 01 00 00 00 00 02 b3 0b                                                                               
                                39 01 00 00 00 00 02 00 80                                                                               
                                39 01 00 00 00 00 0a c0 00 64 00 10 10 00 64 10 10                                       
                                39 01 00 00 00 00 02 00 90                                   
                                39 01 00 00 00 00 07 c0 00 5c 00 01 00 04                                                      
                                39 01 00 00 00 00 02 00 a4                                     
                                39 01 00 00 00 00 02 c0 22                                                                               
                                39 01 00 00 00 00 02 00 b3
                                39 01 00 00 00 00 03 c0 00 50                                                                          
                                39 01 00 00 00 00 02 00 81                                 
                                39 01 00 00 00 00 02 c1 55                                                                               
                                39 01 00 00 00 00 02 00 90                           
                                39 01 00 00 00 00 02 c4 49                                                                               
                                39 01 00 00 00 00 02 00 a0                                    
                                39 01 00 00 00 00 0f c4 05 10 04 02 05 15 11 05 10 05 02 05 15 11              
                                39 01 00 00 00 00 02 00 b0                              
                                39 01 00 00 00 00 03 c4 00 00                                                                          
                                39 01 00 00 00 00 02 00 91             
                                39 01 00 00 00 00 03 c5 49 50                                                                          
                                39 01 00 00 00 00 02 00 00                    
                                39 01 00 00 00 00 03 d8 9d 9d                                                                          
                                39 01 00 00 00 00 02 00 00                
                                39 01 00 00 00 00 02 d9 5e                                                                               
                                39 01 00 00 00 00 02 00 81                      
                                39 01 00 00 00 00 02 c4 82                                                                               
                                39 01 00 00 00 00 02 00 b0                    
                                39 01 00 00 00 00 03 c5 04 38   //b8                                                                       
                                39 01 00 00 00 00 02 00 bb                      
                                39 01 00 00 00 00 02 c5 80                                                                               
                                39 01 00 00 00 00 02 00 82             
                                39 01 00 00 00 00 02 C4 02                                                                               
                                39 01 00 00 00 00 02 00 00                               
                                39 01 00 00 00 00 02 d0 40                                                                               
                                39 01 00 00 00 00 02 00 00                                       
                                39 01 00 00 00 00 03 d1 00 00                                                                          
                                39 01 00 00 00 00 02 00 80         
                                39 01 00 00 00 00 02 c4 00                                                                               
                                39 01 00 00 00 00 02 00 98                  
                                39 01 00 00 00 00 02 c5 10                                                                               
                                39 01 00 00 00 00 02 00 81                                                                               
                                39 01 00 00 00 00 02 f5 15
                                39 01 00 00 00 00 02 00 83                                                                               
                                39 01 00 00 00 00 02 f5 15                                    
                                39 01 00 00 00 00 02 00 85                                                                               
                                39 01 00 00 00 00 02 f5 15                               
                                39 01 00 00 00 00 02 00 87                                                                               
                                39 01 00 00 00 00 02 f5 15                                     
                                39 01 00 00 00 00 02 00 89                                                                               
                                39 01 00 00 00 00 02 f5 15                                     
                                39 01 00 00 00 00 02 00 8b                                                                               
                                39 01 00 00 00 00 02 f5 15                    
                                39 01 00 00 00 00 02 00 95                                                                               
                                39 01 00 00 00 00 02 f5 15                                 
                                39 01 00 00 00 00 02 00 97                                                                               
                                39 01 00 00 00 00 02 f5 15                        
                                39 01 00 00 00 00 02 00 99                                                                               
                                39 01 00 00 00 00 02 f5 15              
                                39 01 00 00 00 00 02 00 a1                                                                               
                                39 01 00 00 00 00 02 f5 15                                                  
                                39 01 00 00 00 00 02 00 a3                                                                               
                                39 01 00 00 00 00 02 f5 15                                          
                                39 01 00 00 00 00 02 00 a5                                                                               
                                39 01 00 00 00 00 02 f5 15                                              
                                39 01 00 00 00 00 02 00 a7                                                                               
                                39 01 00 00 00 00 02 f5 15                                         
                                39 01 00 00 00 00 02 00 ab                                                                               
                                39 01 00 00 00 00 02 f5 18                                          
                                39 01 00 00 00 00 02 00 b1                           
                                39 01 00 00 00 00 0e f5 15 00 00 00 00 00 00 00 00 02 15 08 15                   
                                39 01 00 00 00 00 02 00 b4                     
                                39 01 00 00 00 00 02 c5 c0                 
                                39 01 00 00 00 00 02 00 90                                  
                                39 01 00 00 00 00 05 f5 02 11 02 11                                                                
                                39 01 00 00 00 00 02 00 90                      
                                39 01 00 00 00 00 02 c5 50                                                                               
                                39 01 00 00 00 00 02 00 94                                            
                                39 01 00 00 00 00 02 c5 66                                                                               
                                39 01 00 00 00 00 02 00 80                             
                                39 01 00 00 00 00 0c cb 00 00 00 00 00 00 00 00 00 00 00                             
                                39 01 00 00 00 00 02 00 90                                     
                                39 01 00 00 00 00 10 cb 00 00 00 00 00 00 00 00 00 00 00 ff 00 ff 00         
                                39 01 00 00 00 00 02 00 a0                                     
                                39 01 00 00 00 00 10 cb ff 00 ff 00 00 00 00 00 00 00 00 00 00 00 00         
                                39 01 00 00 00 00 02 00 b0                                     
                                39 01 00 00 00 00 10 cb 00 00 00 ff 00 ff 00 ff 00 ff 00 00 00 00 00         
                                39 01 00 00 00 00 02 00 c0                                     
                                39 01 00 00 00 00 10 cb 00 00 00 00 00 00 00 05 05 00 05 05 05 05 05         
                                39 01 00 00 00 00 02 00 d0                                     
                                39 01 00 00 00 00 10 cb 05 05 05 05 05 00 00 00 00 00 00 00 00 00 05         
                                39 01 00 00 00 00 02 00 e0                                    
                                39 01 00 00 00 00 0f cb 05 00 05 05 05 05 05 05 05 05 05 05 00 00              
                                39 01 00 00 00 00 02 00 f0                                     
                                39 01 00 00 00 00 0c cb ff ff ff ff ff ff ff ff ff ff ff                             
                                39 01 00 00 00 00 02 00 80                                     
                                39 01 00 00 00 00 10 cc 00 00 00 00 00 00 00 05 07 00 0d 09 0f 0b 11         
                                39 01 00 00 00 00 02 00 90                                      
                                39 01 00 00 00 00 10 cc 15 13 17 01 03 00 00 00 00 00 00 00 00 00 06         
                                39 01 00 00 00 00 02 00 a0                                   
                                39 01 00 00 00 00 0f cc 08 00 0e 0a 10 0c 12 16 14 18 02 04 00 00              
                                39 01 00 00 00 00 02 00 b0                               
                                39 01 00 00 00 00 10 cc 00 00 00 00 00 00 00 04 02 00 0c 10 0a 0e 18         
                                39 01 00 00 00 00 02 00 c0                               
                                39 01 00 00 00 00 10 cc 14 16 12 08 06 00 00 00 00 00 00 00 00 00 03         
                                39 01 00 00 00 00 02 00 d0                                 
                                39 01 00 00 00 00 0f cc 01 00 0b 0f 09 0d 17 13 15 11 07 05 00 00              
                                39 01 00 00 00 00 02 00 80                                        
                                39 01 00 00 00 00 0d ce 87 03 28 86 03 28 85 03 28 84 03 28                        
                                39 01 00 00 00 00 02 00 90                                      
                                39 01 00 00 00 00 0f ce 34 fc 28 34 fd 28 34 fe 28 34 ff 28 00 00              
                                39 01 00 00 00 00 02 00 a0                                     
                                39 01 00 00 00 00 0f ce 38 07 05 00 00 28 00 38 06 05 01 00 28 00              
                                39 01 00 00 00 00 02 00 b0                                   
                                39 01 00 00 00 00 0f ce 38 05 05 02 00 28 00 38 04 05 03 00 28 00              
                                39 01 00 00 00 00 02 00 c0                                    
                                39 01 00 00 00 00 0f ce 38 03 05 04 00 28 00 38 02 05 05 00 28 00              
                                39 01 00 00 00 00 02 00 d0                                   
                                39 01 00 00 00 00 0f ce 38 01 05 06 00 28 00 38 00 05 07 00 28 00              
                                39 01 00 00 00 00 02 00 80                                     
                                39 01 00 00 00 00 0f cf 78 07 04 ff 00 18 10 78 06 05 00 00 18 10              
                                39 01 00 00 00 00 02 00 90                                     
                                39 01 00 00 00 00 0f cf 78 05 05 01 00 18 10 78 04 05 02 00 18 10              
                                39 01 00 00 00 00 02 00 a0                                   
                                39 01 00 00 00 00 0f cf 70 00 05 00 00 18 10 70 01 05 01 00 18 10              
                                39 01 00 00 00 00 02 00 b0                                     
                                39 01 00 00 00 00 0f cf 70 02 05 02 00 18 10 70 03 05 03 00 18 10              
                                39 01 00 00 00 00 02 00 c0                                        
                                39 01 00 00 00 00 0c cf 01 01 20 20 00 00 01 81 00 03 08         
                                39 01 00 00 00 00 02 00 00 			                                                                        
                                39 01 00 00 00 00 11 E1 00 05 09 0D 06 0C 0C 0C 03 06 15 0F 17 28 1C 06 // 39 01 00 00 00 00 11 E1 00 04 08 0B 04 0D 0C 0C 03 06 12 0F 17 30 25 06  
                                39 01 00 00 00 00 02 00 00                                                                               
                                39 01 00 00 00 00 11 E2 00 05 09 0D 06 0C 0C 0C 03 06 15 0F 17 28 1C 06 // 39 01 00 00 00 00 11 E2 00 04 08 0B 04 0D 0C 0C 03 06 12 0F 17 30 25 06
/* color enhance */                               
                                15 01 00 00 01 00 02 00 a0
                                39 01 00 00 01 00 0d d6 01 cd 01 cd 01 cd 01 cd 01 cd 01 cd
                                15 01 00 00 01 00 02 00 B0
                                39 01 00 00 01 00 0d d6 01 cd 01 cd 01 cd 01 cd 01 cd 01 cd
                                15 01 00 00 01 00 02 00 c0
                                39 01 00 00 01 00 0d d6 89 11 89 89 11 89 89 11 89 89 11 89
                                15 01 00 00 01 00 02 00 d0
                                39 01 00 00 01 00 07 d6 89 11 89 89 11 89
                                15 01 00 00 01 00 02 00 E0
                                39 01 00 00 01 00 0d d6 44 11 44 44 11 44 44 11 44 44 11 44
                                15 01 00 00 01 00 02 00 F0
                                39 01 00 00 01 00 07 d6 44 11 44 44 11 44
                                15 01 00 00 01 00 02 00 90                   
                                15 01 00 00 01 00 02 d6 80
                                15 01 00 00 01 00 02 00 00                   
                                15 01 00 00 01 00 02 55 B0
                                15 01 00 00 01 00 02 00 81                   
                                39 01 00 00 01 00 03 d6 00 ff
/**/                                   
                                39 01 00 00 00 00 02 00 00                                          
                                39 01 00 00 14 00 04 ff ff ff ff                                                                   
                                05 01 00 00 78 00 02 11 00 
                                05 01 00 00 32 00 02 29 00];
		qcom,mdss-dsi-on-command-state = "dsi_lp_mode";
		qcom,mdss-dsi-off-command = [05 01 00 00 32 00 02 28 00
					                 05 01 00 00 78 00 02 10 00];
                qcom,mdss-dsi-off-command-state = "dsi_hs_mode";
        };
};