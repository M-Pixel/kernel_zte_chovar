## drivers/video/msm/mdss/sii8240/Kconfig
```kconfig
#
# HDMI to MHL  device configuration
#

menu "MHL sii8240 support"

config MHL_SII8240
	tristate "MHL_Sii8240"
	default n
	help
	  If you say yes here you get support for the MHL_Sii8240 transimitter.

	  This driver can also be built as a module.  If so, the module
	  will be called MHL_Sii8240.

endmenu
```
